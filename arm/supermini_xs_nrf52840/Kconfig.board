## arm/supermini_xs_nrf52840/Kconfig.board
```kconfig
# Super Mini NRF52840 XS Kconfig.board
# Copyright (c) 2024 JensB
# SPDX-License-Identifier: Apache-2.0

config BOARD_SUPERMINI_XS_NRF52840
	bool "Super Mini NRF52840 XS"
	depends on SOC_NRF52840_QIAA
```

## arm/supermini_xs_nrf52840/Kconfig.defconfig
```kconfig
# Super Mini NRF52840 XS board Kconfig.defconfig
# Copyright (c) 2024 JensB
# SPDX-License-Identifier: Apache-2.0

if BOARD_SUPERMINI_XS_NRF52840

config BOARD
	default "supermini_xs_nrf52840"

config BT_CTLR
	default BT

config BOARD_ENABLE_DCDC
	bool "DCDC mode"
	select SOC_DCDC_NRF52X
	default y

config BOARD_ENABLE_DCDC_HV
	bool "High Voltage DCDC converter"
	select SOC_DCDC_NRF52X_HV
	default y

endif # BOARD_SUPERMINI_XS_NRF52840


if USB_DEVICE_STACK

config UART_CONSOLE
	default CONSOLE

config USB_DEVICE_INITIALIZE_AT_BOOT
	default y

endif # USB_DEVICE_STACK
```

## arm/supermini_xs_nrf52840/supermini_xs_nrf52840_defconfig
```kconfig
# SPDX-License-Identifier: Apache-2.0

CONFIG_SOC_SERIES_NRF52X=y
CONFIG_SOC_NRF52840_QIAA=y
CONFIG_BOARD_SUPERMINI_XS_NRF52840=y

# enable MPU
CONFIG_ARM_MPU=y
CONFIG_HW_STACK_PROTECTION=y

# enable peripherals
CONFIG_GPIO=y
CONFIG_SERIAL=y
CONFIG_PINCTRL=y

# enable console
CONFIG_CONSOLE=y
CONFIG_UART_CONSOLE=y

# Logger cannot use itself to log
CONFIG_USB_CDC_ACM_LOG_LEVEL_OFF=y

# enable sam-ba bootloader
CONFIG_BOOTLOADER_BOSSA=y
CONFIG_BOOTLOADER_BOSSA_LEGACY=y
```
